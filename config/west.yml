## config/west.yml
```yaml
manifest:
  remotes:
    - name: zmkfirmware
      url-base: https://github.com/zmkfirmware
    - name: carrefinho
      url-base: https://github.com/carrefinho
  projects:
    - name: zmk
      remote: zmkfirmware
      revision: e34793e
      import: app/west.yml
    - name: prospector-zmk-module
      remote: carrefinho
      revision: main
  self:
    path: config
```
